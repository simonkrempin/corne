## boards/shields/corne_xiao/Kconfig.defconfig
```kconfig
if SHIELD_CORNE_LEFT

config ZMK_KEYBOARD_NAME
	default "CorneXiao"

config ZMK_SPLIT_ROLE_CENTRAL
	default y

endif

if SHIELD_CORNE_XIAO_LEFT || SHIELD_CORNE_XIAO_RIGHT

config ZMK_SPLIT
	default y

BT_CTRL_TX_PWR_PLUS_8=y

endif
```
